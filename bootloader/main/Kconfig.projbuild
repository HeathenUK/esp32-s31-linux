## bootloader/main/Kconfig.projbuild
```kconfig
menu "S31 console"

config S31_QUIET_PM_LOG
	bool "Silence the power manager's frequency-switching log"
	default y
	help
	  The power manager logs a line at INFO every time it reconfigures the
	  APB frequency, which on this board is several times a second. hart0 and
	  Linux share UART0, so those lines land in the middle of whatever Linux
	  is printing: they corrupt framed transfers, they are read back as
	  command output by any script driving the console, and they interleave
	  into benchmark results.

	  Leaves every other hart0 log at its normal level - only the "pm" tag is
	  raised to WARN. Turn this off when actually debugging frequency
	  switching.

endmenu

menu "S31 display"

config S31_DISPLAY_ENABLE
	bool "Bring up the Korvo-1 RGB LCD in the loader"
	default n
	help
	  Configures the LCD_CAM RGB panel (800x480 RGB565, ESP32-S3-LCD-EV-Board
	  -SUB3 subboard) and leaves a self-refreshing AXI DMA ring scanning the
	  framebuffer out across the handoff to Linux.

	  The LCD data bus uses GPIO33 and GPIO34, which are also the USB
	  Serial/JTAG D-/D+ pads. Enabling this therefore requires the console to
	  be moved off USB Serial/JTAG (set CONFIG_ESP_CONSOLE_UART_DEFAULT), and
	  costs JTAG debugging. The USB 2.0 OTG host port is unaffected: it uses
	  the dedicated USB_DP/USB_DM analog pads.

if S31_DISPLAY_ENABLE

config S31_DISPLAY_PCLK_GPIO
	int "LCD pixel clock GPIO"
	default 40

config S31_DISPLAY_HSYNC_GPIO
	int "LCD horizontal sync GPIO"
	default 44

config S31_DISPLAY_VSYNC_GPIO
	int "LCD vertical sync GPIO"
	default 45

config S31_DISPLAY_DE_GPIO
	int "LCD data enable GPIO"
	default 43

config S31_DISPLAY_HOLD_HART1
	bool "Diagnostic: bring up the LCD but never release hart1 to Linux"
	default n
	help
	  Isolates the display from Linux entirely. If the panel stays correct
	  with this set but degrades without it, the fault is something Linux
	  does after the handoff; if it degrades either way, the fault is in the
	  loader's own LCD_CAM or DMA setup. Diagnostic only - the board will
	  not boot Linux.

config S31_DISPLAY_DISP_GPIO
	int "LCD display-enable GPIO (-1 to omit)"
	default -1
	help
	  Espressif's own Korvo-1 board definition uses -1 (no DISP pin).
	  GPIO38 is LCD_CS and Boot Mode 0 on this board, so driving it as a
	  display-enable holds the panel dark.

endif

endmenu

menu "S31 audio co-processor"

config S31_AUDIO_ENABLE
	bool "Enable FreeRTOS-owned ES8311 audio"
	default y

if S31_AUDIO_ENABLE

config S31_AUDIO_HOST_CODEC
	bool "Linux owns the audio codec over I2C"
	depends on S31_AUDIO_ENABLE
	default y
	help
	  Bring up I2S and the shared rings here, but leave codec control to
	  Linux, which reaches the codec over its own I2C controller.

	  This is required on the ESP32-S31-Korvo-1. Its codec is an ES8389
	  rather than the ES8311 this firmware can drive, and the codec shares
	  one I2C bus with the touch controller on GPIO0/GPIO1. Only one
	  peripheral can drive those pads, so the side with a working driver
	  for the part takes the bus - and that is Linux, which has the
	  mainline ES8389 driver.

	  With this set, nothing here touches I2C, so the pins stay available
	  to Linux.

config S31_AUDIO_I2C_SDA
	int "ES8311 I2C SDA GPIO"
	default 51

config S31_AUDIO_I2C_SCL
	int "ES8311 I2C SCL GPIO"
	default 50

config S31_AUDIO_I2S_MCLK
	int "ES8311 I2S MCLK GPIO (-1 to omit)"
	default 52

config S31_AUDIO_I2S_BCLK
	int "ES8311 I2S BCLK GPIO"
	default 53

config S31_AUDIO_I2S_WS
	int "ES8311 I2S word-select GPIO"
	default 55

config S31_AUDIO_I2S_DOUT
	int "ES8311 I2S data-out GPIO"
	default 56

config S31_AUDIO_I2S_DIN
	int "ES8311 I2S data-in GPIO"
	default 54

config S31_AUDIO_PA_GPIO
	int "Power amplifier enable GPIO (-1 to omit)"
	default 57

config S31_AUDIO_MIC_RIGHT_SLOT
	bool "ES8311 microphone is in the right I2S slot"
	default n

endif

endmenu

config S31_USB_HID_ENABLE
	bool "Own the USB controller on hart0 and enumerate HID devices"
	default n
	help
	  Take the USB OTG controller for hart0 and drive keyboards and mice
	  with Espressif's USB host stack, instead of leaving the controller to
	  Linux's dwc2.

	  Linux's dwc2 cannot talk to low-speed devices on this board: with the
	  root port forced to full speed a low-speed keyboard fails every
	  transaction (XactErr, "unable to enumerate USB device"), and the only
	  configuration that works costs 39% of a core. See
	  docs/usb-on-hart0-plan.md.

	  There is ONE USB OTG peripheral on this SoC and a peripheral belongs
	  to one hart, so enabling this means Linux has no USB at all - no
	  storage, no serial, nothing. Disable usb_otghs and usb_phy in the
	  device tree when you turn this on.
```

## buildroot-external/package/jwm/Config.in
```kconfig
config BR2_PACKAGE_JWM
	bool "jwm (Joe's Window Manager)"
	depends on BR2_PACKAGE_XORG7
	depends on BR2_USE_MMU
	select BR2_PACKAGE_XLIB_LIBX11
	select BR2_PACKAGE_XLIB_LIBXFT
	select BR2_PACKAGE_XLIB_LIBXPM
	select BR2_PACKAGE_XLIB_LIBXEXT
	help
	  A window manager with title bars, buttons, a taskbar and a root menu,
	  written in C against Xlib.

	  It replaces evilwm, which was chosen for size alone and draws nothing
	  but a one-pixel border - no title bars, no close/maximise/minimise, no
	  taskbar. fluxbox and openbox have those, but are C++ and would bring
	  libstdc++ (1,655,438) back onto a board that currently has no C++
	  runtime at all.

	  Reuses libX11, libXft and libXpm, already in the flash image.

	  https://joewing.net/projects/jwm/
```

## buildroot-external/package/prboomplus/Config.in
```kconfig
config BR2_PACKAGE_PRBOOMPLUS
	bool "prboom-plus"
	select BR2_PACKAGE_SDL
	select BR2_PACKAGE_SDL_MIXER
	select BR2_PACKAGE_SDL_NET
	help
	  PrBoom+ 2.5.1.4, the last SDL 1.2 release of the maintained
	  PrBoom fork. Built alongside prboom 2.5.0 so the two engines
	  can be compared with the graphics library held constant.

	  https://github.com/coelckers/prboom-plus
```

## buildroot-external/package/rrootage/Config.in
```kconfig
config BR2_PACKAGE_RROOTAGE
	bool "rrootage"
	depends on BR2_PACKAGE_HAS_LIBGL
	depends on BR2_INSTALL_LIBSTDCPP
	select BR2_PACKAGE_SDL
	select BR2_PACKAGE_SDL_MIXER
	select BR2_PACKAGE_LIBGLU
	help
	  rRootage 0.23a (Kenta Cho, 2003), an SDL 1.2 + OpenGL 1.x
	  shooter: the first real GL game of docs/gl-plan-2026-09-25.md
	  stage 5a. Stock source (Debian's orig tarball, byte-identical to
	  upstream's), no patches. Run with -lowres (320x240) -window.

	  http://www.asahi-net.or.jp/~cs8k-cyu/windows/rr_e.html
```

## buildroot-external/package/s31-libgl/Config.in
```kconfig
config BR2_PACKAGE_S31_LIBGL
	bool "s31-libgl"
	depends on BR2_PACKAGE_XORG7
	# Exactly one libgl provider may exist, and mesa3d-headers
	# (selected below) refuses to coexist with mesa3d.
	depends on !BR2_PACKAGE_MESA3D
	depends on !BR2_PACKAGE_LIBGLVND
	select BR2_PACKAGE_HAS_LIBGL
	select BR2_PACKAGE_MESA3D_HEADERS
	select BR2_PACKAGE_XLIB_LIBX11
	select BR2_PACKAGE_XLIB_LIBXEXT
	help
	  The board's own OpenGL 1.x library: erysdren TinyGL grown
	  by us, with a client-side GLX 1.4 and an MIT-SHM present
	  path, built from gl/ in this repository.

	  This is a Buildroot "libgl" provider, like nvidia-driver or
	  mesa3d, so the stock GL packages (libglu, libfreeglut,
	  mesa3d-demos, later the games) build against it unmodified.
	  It installs libGL.so.1 (Mesa's soname, which SDL and freeglut
	  dlopen by name), gl.pc and glx.pc. The GL/ and KHR/ headers
	  come from mesa3d-headers.

	  See docs/gl-plan-2026-09-25.md and docs/gl-packaging.md.

if BR2_PACKAGE_S31_LIBGL

config BR2_PACKAGE_PROVIDES_LIBGL
	default "s31-libgl"

config BR2_PACKAGE_S31_LIBGL_SDL_OPENGL
	bool "SDL 1.2 with OpenGL (plan stage 5a)"
	depends on BR2_PACKAGE_SDL_X11
	# SDL 1.2's configure probe compiles GL/gl.h, GL/glx.h AND
	# GL/glu.h (configure.in:1660-1663); without glu.h staged it
	# silently builds GL-off even when asked.
	select BR2_PACKAGE_LIBGLU
	help
	  Off by default. With this off, SDL 1.2 is configured with an
	  explicit --disable-video-opengl, so staging GL headers can
	  never flip it on (its configure otherwise enables GL whenever
	  GL/gl.h, GL/glx.h and GL/glu.h are in staging, and sdl.mk
	  passes no switch). With it on, SDL 1.2 gets
	  --enable-video-opengl and is ordered after libgl and libglu.

	  Only SDL_OPENGL video modes pick a GL visual in SDL 1.2
	  (SDL_x11video.c:928-936), so software SDL 1.2 apps keep their
	  path. The stage-5a gate in docs/gl-plan-2026-09-25.md section
	  4.2 decides whether this ships.

config BR2_PACKAGE_S31_LIBGL_SDL2_NO_GL_RENDERER
	bool "SDL2: GL contexts, but no SDL OpenGL render driver"
	default y
	depends on BR2_PACKAGE_SDL2_OPENGL
	help
	  Only reachable once BR2_PACKAGE_SDL2_OPENGL is enabled (plan
	  stage 5b); it is inert until then.

	  A post-configure hook deletes SDL_VIDEO_RENDER_OGL from the
	  generated SDL_config.h, so SDL_internal.h defaults it to 0:
	  GL contexts work for apps that ask for SDL_WINDOW_OPENGL, but
	  "opengl" never enters SDL_CreateRenderer's list and the
	  window-surface probe keeps today's X11/MIT-SHM path for every
	  app that does not ask for GL (plan section 4.2, option B).

	  Say n only to measure SDL's own GL renderer on purpose.

endif

comment "s31-libgl needs X.org and no other OpenGL provider"
	depends on !BR2_PACKAGE_XORG7 || BR2_PACKAGE_MESA3D || \
		BR2_PACKAGE_LIBGLVND
```

## buildroot-external/package/st/Config.in
```kconfig
config BR2_PACKAGE_ST
	bool "st (suckless simple terminal)"
	depends on BR2_PACKAGE_XORG7
	depends on BR2_USE_MMU # fork()
	select BR2_PACKAGE_XLIB_LIBX11
	select BR2_PACKAGE_XLIB_LIBXFT
	select BR2_PACKAGE_FONTCONFIG
	help
	  A terminal emulator that draws with Xft and nothing else.

	  It exists here to replace xterm, whose Athena dependency chain -
	  xterm, libXaw7, libXt, libXmu, libXpm, libncursesw, libICE, libSM -
	  totals 1,957,904 bytes and does not fit in the XIP flash image. That
	  chain therefore paged off the SD card on every window redraw, which is
	  what made dragging a window laggy.

	  st needs only libX11, libXft, fontconfig and freetype, all of which
	  are already in the flash image for the server, so it costs roughly
	  100 kB and executes in place.

	  https://st.suckless.org/
```

## buildroot-external/package/x11libre-xserver/Config.in
```kconfig
config BR2_PACKAGE_X11LIBRE_XSERVER
	bool "X11Libre Xfbdev server"
	depends on BR2_USE_MMU
	select BR2_PACKAGE_XORGPROTO
	select BR2_PACKAGE_XLIB_LIBXFONT2
	select BR2_PACKAGE_XLIB_XTRANS
	select BR2_PACKAGE_PIXMAN
	help
	  Xfbdev, the kdrive framebuffer X server, from the X11Libre fork of
	  xorg-server.

	  Upstream xorg-server dropped the small kdrive servers - 21.1.23 ships
	  only Xephyr, which needs a host X server. X11Libre restores Xfbdev on
	  a modern, actively maintained codebase, which matters here because the
	  full Xorg server plus its modules measures 3.0 MB against a flash
	  budget of roughly 7.4 MB shared with everything else.

	  Draws into /dev/fb0. On this board that is the DRM driver's fbdev
	  emulation, so writes still reach the plane update path and keep PPA
	  scaling and the reduced render size.

	  https://github.com/X11Libre/xserver
```

## buildroot-external/package/xfiles/Config.in
```kconfig
config BR2_PACKAGE_XFILES
	bool "xfiles (X11 file manager)"
	depends on BR2_PACKAGE_XORG7
	depends on BR2_USE_MMU
	select BR2_PACKAGE_XLIB_LIBX11
	select BR2_PACKAGE_XLIB_LIBXFT
	select BR2_PACKAGE_XLIB_LIBXPM
	select BR2_PACKAGE_XLIB_LIBXCURSOR
	select BR2_PACKAGE_XLIB_LIBXRENDER
	select BR2_PACKAGE_FONTCONFIG
	help
	  A file manager written directly against Xlib - no toolkit, no C++,
	  no glib. About 5,000 lines of C99 with its own widget layer.

	  It is here because it is the only maintained, glib-free, resizable
	  X11 file manager that fits this board. Everything else is a terminal
	  application, unmaintained, or built on GTK/Qt/FOX/Tk and 5-20x over
	  budget. Of its dependencies only libXpm is not already in the flash
	  image for the X server.

	  Note file operations - copy, move, delete - are delegated to a shell
	  script, examples/xfilesctl, which this package installs. Browsing,
	  navigation, selection and launching work without it.

	  https://github.com/phillbush/xfiles
```
